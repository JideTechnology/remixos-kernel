## drivers/external_drivers/camera/drivers/media/i2c/crmrd/Kconfig
```kconfig
config VIDEO_OV2680
       tristate "Omnivision OV2680 sensor support"
       depends on I2C && VIDEO_V4L2
       ---help---
         This is a Video4Linux2 sensor-level driver for the Omnivision
         OV2680 raw camera.

         ov2680 is a 2M raw sensor.

         It currently only works with the atomisp driver.

config VIDEO_OV8858
       tristate "Omnivision ov8858 sensor support"
       depends on I2C && VIDEO_V4L2 && VIDEO_ATOMISP
       ---help---
         This is a Video4Linux2 sensor-level driver for the Omnivision
         ov8858 RAW sensor.

         OV8858 is a 8M raw sensor.

         It currently only works with the atomisp driver.
```

## drivers/external_drivers/camera/drivers/media/i2c/unicam/Kconfig
```kconfig
config VIDEO_UNICAM
       tristate "intel unicamera sensor support"
       default m
       depends on I2C && VIDEO_V4L2
       ---help---
	intel unicamera sensor support
```

## drivers/external_drivers/camera/drivers/media/i2c/unicam/soc/Kconfig
```kconfig
config VIDEO_GC0310
        tristate "GalaxyCore GC0310 sensor support"
        depends on I2C && VIDEO_V4L2
        ---help---
          This is a Video4Linux2 sensor-level driver for the GalaxyCore
          GC0310 soc camera.

          GalaxyCore is a 0.3M soc sensor.

          It currently only works with the atomisp driver.
```

## drivers/hwmon/light/Kconfig
```kconfig
#
# Light sensors
#
# When adding new entries keep the list in alphabetical order

menu "Light sensors"


config SENSORS_CM3218
	depends on I2C
	tristate "CM3218 driver"
	help
	 Say Y here if you use cm3218.
	 This option enables ambient light sensor using
	 Capella cm3218 device driver.

	 To compile this driver as a module, choose M here:
	 the module will be called cm3218.

config SENSORS_CM36283
	depends on I2C
	tristate "CM36283 driver"
	help
	 Say Y here if you use cm36283.
	 This option enables ambient light sensor using
	 Capella cm36283 device driver.

	 To compile this driver as a module, choose M here:
	 the module will be called cm36283.
endmenu
```

## drivers/input/misc/BMG160/Kconfig
```kconfig
#
# Makefile for Bosch sensors driver.
#
config SENSORS_BMG
	tristate "Bosch Gyroscope Sensor Driver"
	depends on I2C
	help
	 If you say yes here, you get support for Bosch Sensortec's
	 gyroscope sensor drivers of BMG160/BMI055/BMI058 e.t.c.

config SENSORS_BMG_FIFO
	tristate "Bosch Gyroscope FIFO Support"
	depends on SENSORS_BMG
	help
	 If you say yes here, you get support for Gyroscope sensor FIFO operations.

config SENSORS_BMI058
	tristate "BMI058 Sensor Support"
	depends on (SENSORS_BMG || SENSORS_BMA2X2)
	help
	 If you say yes here, you get support for Bosch Sensortec's
	 sensor driver of BMI058.
```

## drivers/input/misc/bosch/Kconfig
```kconfig
#
# Makefile for Bosch sensors driver.
#
config SENSORS_BMI160
	tristate "BMI160 Sensor Support"
		depends on I2C || SPI_MASTER
			help
				 If you say yes here, you get support for Bosch Sensortec's
					 sensor driver of BMI160.

config SENSORS_BMI160_I2C
	tristate "support I2C bus communication"
	depends on SENSORS_BMI160 && I2C
	help
	 If you say yes here, you get support Bosch Sensortec's BMI160 sensor hooked to an I2C bus.

config SENSORS_BMI160_SPI
tristate "support SPI bus communication"
depends on SENSORS_BMI160 && SPI_MASTER
	help
	 If you say yes here, you get support Bosch Sensortec's BMI160 sensor hooked to an SPI bus.

config BMI160_MAG_INTERFACE_SUPPORT
tristate "BMI160 Sensor mag interface support"
depends on SENSORS_BMI160
	help
	 If you say yes here, you get support for Bosch Sensortec's
	 sensor driver of BMI160 with mag sensor support.

config SENSORS_BMI160_ENABLE_INT1
tristate "BMI160 sensor interrupt INT1 support"
depends on SENSORS_BMI160
	help
	 If you say yes here, you get INT1 support for Bosch Sensortec
	 sensors BMI160.

config SENSORS_BMI160_ENABLE_INT2
tristate "BMI160 sensor interrupt INT2 support"
depends on SENSORS_BMI160
	help
	 If you say yes here, you get INT2 support for Bosch Sensortec
	 sensors BMI160.
```

## drivers/input/misc/compass/Kconfig
```kconfig
#
# Kconfig for stand-alone compass input device drivers
#

config INV_AK8975
    tristate "Invensense AKM AK8975 compass input device driver"
    depends on I2C && SYSFS && INPUT && INPUT_EVDEV
    default n
    help
      This driver supports the AKM AK8975 compass device.
      This driver can be built as a module. The module will be called
      inv-ak8975.
      
config INV_MMC3416X
	tristate "MMC3416xPJ magnetic sensor support"
	depends on I2C && SYSFS && INPUT && INPUT_EVDEV
	default n
	help
	  If you say yes here you get support for MEMSIC's 
	  magnetic sensors MMC3416xPJ.
	  inv-mmc3416x.
```

## drivers/input/misc/dyna/Kconfig
```kconfig
config DI_ACCEL
	tristate "DynaImage accelerometer"
	depends on I2C
	help
		This driver supports DynaImage accelerometer.

config DI_3133
	tristate "DynaImage DI3133 accelerometer input device driver"
	depends on I2C
	help
		This driver supports the DI3133 accelerometer.

config DI_AMBIENT_LIGHT
	tristate "DynaImage ambient light sensor"
	depends on I2C
	help
		This driver supports DynaImage ambient light sensor.

config SENSORS_AL3320
	tristate "DynaImage AL3320 input device driver"
	depends on I2C
	help
	  This driver supports the AL3320 ambient light sensor.

config DI_MISC
	tristate "DynaImage misc"
	depends on I2C
	help
	  This driver supports the DI5112 misc.
```

## drivers/input/touchscreen/ftxxxx/Kconfig
```kconfig
config CC_TOUCHSCREEN_FT5526
	tristate "FocalTech FT5526 touchscreen"
	depends on I2C
	help
	  Say Y here if you have a FocalTech FT5526 series
	  touchscreen chip.

	  If unsure, say N.

	  To compile this driver as a module, Choose M here: the
	  module will be called ftxxxx.
	  
config CC_TOUCHSCREEN_FT5626
	tristate "FocalTech FT5626 touchscreen"
	depends on I2C
	help
	  Say Y here if you have a FocalTech FT5626 series
	  touchscreen chip.

	  If unsure, say N.

	  To compile this driver as a module, Choose M here: the
	  module will be called ftxxxx.

config CC_TOUCHSCREEN_FT5726
        tristate "FocalTech FT5726 touchscreen"
        depends on I2C
        help
          Say Y here if you have a FocalTech FT5726 series
          touchscreen chip.

          If unsure, say N.

          To compile this driver as a module, Choose M here: the
          module will be called ftxxxx.
```

## drivers/input/touchscreen/gt9xx/Kconfig
```kconfig
config CC_TOUCHSCREEN_GT9271
	tristate "goodix gt9271 touchscreen"
	depends on I2C
	help
	  Say Y here if you have a Goodix GT9271 series
	  touchscreen chip.

	  If unsure, say N.

	  To compile this driver as a module, Choose M here: the
	  module will be called gt9xx.
	  
config CC_TOUCHSCREEN_GT9110
	tristate "goodix gt9110 touchscreen"
	depends on I2C
	help
	  Say Y here if you have a Goodix GT110 series
	  touchscreen chip.

	  If unsure, say N.

	  To compile this driver as a module, Choose M here: the
	  module will be called gt9xx.
	
```

## drivers/input/touchscreen/icn85xx/Kconfig
```kconfig
config TOUCHSCREEN_ICN85XX
	tristate "icn85xx touchscreen"
	depends on I2C
	default n
	help
	  Say Y here if you have a icn85xx touchscreen.
```

## drivers/input/touchscreen/silead/Kconfig
```kconfig
config TOUCHSCREEN_SILEAD
	tristate "SILEAD I2C Touchscreen"
	depends on I2C && INPUT
	help
	  Say Y here if you have SILEAD gslx68x series I2C touch screen,
	  such as GSL2681, connected to your system.

	  If unsure, say N.

	  To compile this driver as a module, choose M here: the
	  module will be called gslx68x.
```

## drivers/misc/intel_ld/Kconfig
```kconfig
config INTEL_ST_LD
	tristate "Intel Shared transport driver"
	depends on SERIAL_HSU
	default m
	help
	   Select this module for shared transport driver
```

## drivers/misc/inv_mpu/Kconfig
```kconfig
config MPU_SENSORS_TIMERIRQ
	tristate "MPU Timer IRQ"
	help
	  If you say yes here you get access to the timerirq device handle which
	  can be used to select on.  This can be used instead of IRQ's, sleeping,
	  or timer threads.  Reading from this device returns the same type of
	  information as reading from the MPU and slave IRQ's.

menuconfig INV_SENSORS
	tristate "Motion Processing Unit"
	depends on I2C
	default y

if INV_SENSORS

choice
	tristate "MPU Master"
	depends on I2C && INV_SENSORS
	default MPU_SENSORS_MPU3050

config MPU_SENSORS_MPU3050
	tristate "MPU3050"
	depends on I2C
	select MPU_SENSORS_MPU3050_GYRO
	help
	  If you say yes here you get support for the MPU3050 Gyroscope driver
	  This driver can also be built as a module.  If so, the module
	  will be called mpu3050.
endchoice

config MPU_SENSORS_MPU3050_GYRO
	bool "MPU3050 built in gyroscope"
	depends on MPU_SENSORS_MPU3050

source "drivers/misc/inv_mpu/accel/Kconfig"
source "drivers/misc/inv_mpu/compass/Kconfig"

config MPU_USERSPACE_DEBUG
	bool "MPU Userspace debugging ioctls"
	help
	  Allows the ioctls MPU_SET_MPU_PLATFORM_DATA and
	  MPU_SET_EXT_SLAVE_PLATFORM_DATA, which allows userspace applications
	  to override the slave address and orientation.  This is dangerous
	  and could cause the devices not to work.

endif #INV_SENSORS
```

## drivers/misc/inv_mpu/compass/Kconfig
```kconfig
menuconfig INV_SENSORS_COMPASS
	bool "Compass Slave Sensors"
	default y
	---help---
	  Say Y here to get to see options for device drivers for various
	  compasses. This option alone does not add any kernel code.

	  If you say N, all options in this submenu will be skipped and disabled.

if INV_SENSORS_COMPASS

config MPU_SENSORS_AK8963
        tristate "AKM ak8963"
        help
          This enables support for the AKM ak8963 compass
          This support is for integration with the MPU3050 or MPU6050 gyroscope
          device driver.  Only one compass can be registered at a time.
          Specifying more that one compass in the board file will result
          in runtime errors.



endif
```

## drivers/misc/sunxi-clk-prepare/Kconfig
```kconfig
config SUNXI_CLK_PREPARE
	tristate "allwinnertech clk related modules prepare driver"
	depends on COMMON_CLK && ARCH_SUNXI
	default n
	help
	  This is an option for de-interlace.
```

## drivers/misc/tegra-profiler-android5-0/Kconfig
```kconfig
config TEGRA_PROFILER_ANDROID50
	bool "Enable Tegra profiler"
	depends on ARCH_TEGRA
	help
	  This option enables Tegra profiler
```

## drivers/power/oz1c115/Kconfig
```kconfig
menuconfig OZ1C115
	bool "O2Micro OZ1C115 support"
	help
	  This option enables OZ1C115 driver. If unsure, say Y.

if OZ1C115
config OZ1C115_CHARGER
	bool "OZ1C115 charger driver"
	help
	  Say Y here to enable support for OZ1C115 charger.

config OZ1C115_BATTERY
	bool "OZ1C115 Fuel Gauge driver"
	help
	  Say Y here to enable support for OZ1C115 Fuel Gauge.

endif # OZ1C115
```

## drivers/rmnet/Kconfig
```kconfig
#
# RMNET Driver.
#

config RMNET 
	bool "RMNET driver"
	default y
	---help---
    rmnet driver for connect net and usb cdc-acm
```

## drivers/usb/typec/Kconfig
```kconfig
config USB_TYPEC_FUSB300
	depends on USB_TYPEC
	tristate "FUSB300 TYPEC Connector"
	help
	  Say Y or M here if your system has a Dual Role SuperSpeed
	  USB controller based on the DesignWare FUSB30 IP Core.

	  If you choose to build this driver is a dynamically linked
	  module, the module will be called dwc3.ko.
```

## drivers/usb/typec/pd/Kconfig
```kconfig
config USBC_SYSTEM_POLICY
      depends on USBC_PD
      tristate "Support for USBC Power Delivery System Policy"
      help
      Say Y or M here if your system has a Type-C connector support
      for USB controller based on the USB phy IP Core and support for
      Power Delivery with system policy which shall hold the
      capability of each port based on the PHY registered. This shall
      create an instance of device policy manager for each port(PHY)
      to control the port roles.

      If you choose to build this driver is a dynamically linked
      module, the module will be called system_policy.ko.

config USBC_PD_POLICY
      depends on USBC_SYSTEM_POLICY
      tristate "Support for USB Power Delivery Policy"
      help
      Say Y here if your system has a Type-C connector support
      for USB controller based on the USB phy IP Core and support for
      Power Delivery policies. The PD policy includes the Device
      Policy Manager (DPM), Policy Engine (PE) and Protocol Layers.
```

## sound/soc/intel/board/Kconfig
```kconfig
config SND_SOC_RT5651
	tristate "SOC Machine Audio driver for Intel(R) Anchor8 device"
	depends on X86
	default n
	help
	  This adds support for ASoC machine driver for Intel(R) Anchor8 device
          based on the BYT-CR platform and RT5651 codec.
          Say Y if you have such a device
          If unsure select "N".

config SND_SOC_ES8316
	tristate "SOC Machine Audio driver for Intel(R) Anchor8 device"
	depends on X86
	default n
	help
	  This adds support for ASoC machine driver for Intel(R) Anchor8 device
          based on the BYT-CR platform and RT5651 codec.
          Say Y if you have such a device
          If unsure select "N".
```

## sound/soc/sunxi/Kconfig
```kconfig
#menu "ASoC support for SUNXI"
config SND_SOC_SUNXI_RW
	bool
config SND_SOC_SUNXI_AUDIO_DMA
	bool

config SND_SOC_SUNXI_TDM
	bool
menuconfig SND_SUNXI_SOC
	tristate "ASoC support for SUNXI"
	select SND_SOC_SUNXI_AUDIO_DMA
	#select SND_SOC_SUNXI_RW
	select SND_SOC_DMAENGINE_PCM
	#select SND_SOC_SUNXI_TDM

if SND_SUNXI_SOC
#config SND_SOC_SUNXI_TDM
#	bool
#config SND_SOC_SUNXI_RW
#	bool

config SND_SOC_INTERNAL_AUDIOCODEC
	tristate "ASoC support for audiocodec"
	select SND_SOC_SUNXI_RW
	help
	  Say Y or M if you want to add support for codecs attached to the
	  AUDIOCODEC interface.
config SND_SOC_INTERNAL_I2S
	tristate "ASoC support for internal-i2s"
	select SND_SOC_SUNXI_RW
	help
	  Say Y or M if you want to add support for codecs attached to the
	  INTERNAL I2S interface.

config SND_SOC_AUDIO_CODEC_MACHINE
	tristate "ASoC support for audiocodec machine"
	select SND_SOC_SUNXI_RW
	help
	  Say Y or M if you want to add support for codecs attached to the
	  AUDIOCODEC MACHEINE interface.

config SND_SOC_DAUDIO_PLATFORM
	tristate "ASoC support for daudio platform."
	select SND_SOC_SUNXI_TDM
	help
 	  Say Y or M if you want to add the daudio platform interface.

config SND_SOC_VIRCODEC
	tristate "ASoC support for vircodec."
	help
 	  Say Y or M if you want to add the vircodec interface.

config SND_SOC_DAUDIO0_MACHINE
	tristate "ASoC support for daudio0 machine"
	select SND_SOC_SUNXI_TDM
	help
 	  Say Y or M if you want to add the daudio0 MACHEINE interface.


config SND_SOC_DAUDIO1_MACHINE
	tristate "ASoC support for daudio1 machine"
	select SND_SOC_SUNXI_TDM
	help
 	  Say Y or M if you want to add the daudio1 MACHEINE interface.

config SND_SOC_HDMIAUDIO_PLATFORM
	tristate "ASoC support for hdmiaudio platform."
	select SND_SOC_SUNXI_TDM
	help
 	  Say Y or M if you want to add the hdmi platform interface.


config SND_SOC_HDMIAUDIO_MACHINE_CODEC
	tristate "ASoC support for hdmi machine and hdmi codec"
	select SND_SOC_SUNXI_TDM
	help
 	  Say Y or M if you want to add the hdmi MACHEINE interface and codec interface.

config SND_SUNXI_SOC_SPDIF
	tristate "ASoC support for spdif soundcard"
	help
 	  Say Y or M if you want to add the spdif soundcard include macheine plarform.

config SND_SUNXI_SOC_SUPPORT_AUDIO_RAW
	bool "Support Audio Raw Data"
	depends on (SND_SOC_HDMIAUDIO_MACHINE_CODEC || SND_SUNXI_SOC_SPDIF) && (ARCH_SUN8IW6 || ARCH_SUN8IW7 ||ARCH_SUN9IW1 || ARCH_SUN50I)
	default n
	help
	  Say Y support Audio raw date. It's suitable for Homlet product.

config SUNXI_AUDIO_DEBUG
	bool "Support SUNXI AUDIO DEBUG"
	help
	 this is DEBUG function, add by LSH
	depends on SND_SOC_SUNXI_AUDIO_DMA

endif
#endmenu
```
